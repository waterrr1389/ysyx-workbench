## nemu/src/isa/riscv32/Kconfig
```kconfig
menu "ISA-dependent Options for riscv"

config RV64
  bool "64-bit RISC-V architecture"
  default n

config RVE
  bool "Use E extension"
  default n

choice
  prompt "Instruction decoder"
  depends on !RV64
  default RISCV_DECODER_INSTPAT

config RISCV_DECODER_INSTPAT
  bool "INSTPAT decoder"
  help
    Use the pattern-based decoder, which is the default implementation for ISA
    development.

config RISCV_DECODER_HIERARCHICAL
  bool "Hierarchical decoder"
  help
    Use the optimized opcode-grouped decoder.
endchoice
endmenu
```
